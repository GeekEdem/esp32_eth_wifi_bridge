## tools/c3-programmer/main/Kconfig.projbuild
```kconfig
menu "C3 Programmer Configuration"

    config C3PROG_WIFI_SSID
        string "Default Wi-Fi SSID (optional)"
        default ""
        help
            Normally the network is chosen in the setup portal and saved to
            NVS. A value here is only used while nothing is saved.

    config C3PROG_WIFI_PASSWORD
        string "Default Wi-Fi password (optional)"
        default ""

    config C3PROG_HOSTNAME
        string "Default hostname (DHCP and mDNS)"
        default "c3prog"
        help
            The programmer is reachable as <hostname>.local. Can be changed
            in the web page.

    config C3PROG_WIFI_TX_POWER
        int "Wi-Fi max TX power, 0.25 dBm units (0 = driver default)"
        range 0 84
        default 34
        help
            Many ESP32-C3 SuperMini boards fail to associate at full power
            because of the antenna layout. 34 (8.5 dBm) is the usual fix.
            Set 0 to keep the driver default.

    config C3PROG_RFC2217_PORT
        int "RFC2217 TCP port"
        default 4000

    config C3PROG_UART_NUM
        int "UART port connected to the target"
        default 1

    config C3PROG_UART_TX_GPIO
        int "UART TX GPIO (to target RXD / IO3)"
        default 4

    config C3PROG_UART_RX_GPIO
        int "UART RX GPIO (from target TXD / IO1)"
        default 5

    config C3PROG_UART_BAUD
        int "Default target baud rate"
        default 115200
        help
            Used for the USB path and restored after each network session.

    config C3PROG_EN_GPIO
        int "Target EN GPIO (open-drain)"
        default 6

    config C3PROG_BOOT_GPIO
        int "Target IO0 GPIO (open-drain)"
        default 7

    config C3PROG_BOOT_HOLD_MS
        int "Keep IO0 low at least this long after EN release (ms)"
        default 50
        help
            Guards the bootloader strapping against network jitter when the
            DTR/RTS sequence arrives over RFC2217.

    config C3PROG_EN_HOLD_MAX_MS
        int "Release EN (and IO0) if a client holds EN this long (ms, 0 = never)"
        default 3000
        help
            esptool and idf.py pulse RTS (EN) for about 100 ms. A client that
            vanished while EN was asserted would otherwise keep the target in
            reset forever. Any SET-CONTROL from the client restarts the timer.

    config C3PROG_CLIENT_KEEPALIVE_S
        int "Drop an RFC2217 client that stopped answering after about (s, 0 = never)"
        default 15
        help
            After two thirds of this time without anything from the client, the
            C3 asks it for an answer (telnet DO TIMING-MARK, which pyserial
            rejects with WONT) and drops the connection if none comes within
            the last third. TCP keepalive (first probe after a third of this
            time, then every 2 s) covers a client that has not finished the
            RFC2217 negotiation. Frees the server (one client at a time) and
            releases the target when a laptop sleeps or its route to the C3 is
            gone. The drop is a hard close (RST).

    config C3PROG_BUTTON_GPIO
        int "Button GPIO (-1 = none)"
        default 9
        help
            GPIO9 is the BOOT button on the SuperMini. < 1 s: target
            bootloader; 1-5 s: target reset; 5-10 s: restart the programmer;
            >= 10 s: forget Wi-Fi.

    config C3PROG_LED_GPIO
        int "Status LED GPIO (-1 = none)"
        default 8

    config C3PROG_LED_ACTIVE_LOW
        bool "Status LED is active low"
        default y

endmenu
```

## wt32/main/Kconfig.projbuild
```kconfig
menu "WT32 bridge"

    config WT32_WIFI_SSID
        string "Default Wi-Fi SSID for the client mode (optional)"
        default ""
        help
            Normally the network is chosen on the web page.

    config WT32_WIFI_PASSWORD
        string "Default Wi-Fi password (optional)"
        default ""

    config WT32_HOSTNAME
        string "mDNS name"
        default "wt32"

    config WT32_OWN_IP
        string "Default WT32 address in the own-network mode"
        default "192.168.77.1"
        help
            The network is the /24 around it; DHCP hands out .100-.200.

    config WT32_MGMT_PORT
        int "Management port on the shared IP (client mode)"
        range 1024 32767
        default 28480
        help
            The WT32 answers on the device's IP on this TCP port only.
            Kept below the usual ephemeral ranges (Linux 32768-60999,
            Windows/lwIP 49152-65535) and away from well-known services.

    config WT32_FORWARD_IPV6
        bool "Forward IPv6 in the client mode"
        default n
        help
            IPv6 neighbour discovery carries the device MAC inside the packet,
            which is not rewritten yet. With this off the device is reachable
            over IPv4 only, which avoids half-working IPv6.

    config WT32_SCRIPT_MEM_KB
        int "Memory budget of the user script, KB"
        range 16 96
        default 40
        help
            Allocations of the Berry script beyond this fail as a script error
            instead of starving Wi-Fi, Ethernet and the web server.

    config WT32_I2C_SDA_GPIO
        int "Display I2C SDA GPIO (-1 = no display)"
        default 32
        help
            SSD1306 128x64 on I2C, found at 0x3C or 0x3D. IO32 is labelled
            CFG on the WT32-ETH01 header.

    config WT32_I2C_SCL_GPIO
        int "Display I2C SCL GPIO"
        default 33
        help
            IO33 is labelled 485_EN on the WT32-ETH01 header.

    config WT32_BUTTON_GPIO
        int "Button GPIO, to GND (-1 = none)"
        default 4
        help
            Internal pull-up. Short press: screen on / next page; hold 5 s:
            one-time setup start; hold 10 s: reset of the settings.

    config WT32_DISPLAY_TIMEOUT_S
        int "Screen off after this many seconds without a press (0 = never)"
        range 0 3600
        default 60

    config WT32_ETH_MDC_GPIO
        int "ETH MDC GPIO"
        default 23

    config WT32_ETH_MDIO_GPIO
        int "ETH MDIO GPIO"
        default 18

    config WT32_ETH_PHY_ADDR
        int "ETH PHY address"
        default 1

    config WT32_ETH_PHY_POWER_GPIO
        int "ETH PHY/oscillator power GPIO (-1 = none)"
        default 16

endmenu
```
